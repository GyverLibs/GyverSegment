#include "SegUtils.h"

static const uint8_t _segCharMap[] PROGMEM = {
    0,     //   0x20 32
    0x02,  // ! 0x21 33
    0x22,  // " 0x22 34
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    0x02,  // ` 0x60 96

    // 97..122 lowercase

    0x39,  // { 0x7b 123
    0x06,  // | 0x7c 124
    0x0F,  // } 0x7d 125
    0x40,  // ~ 0x7e 126
};

namespace sseg {

uint8_t getCharCode(char symb) {
    if (symb < 32 || symb > 126) return 0;
    if (symb >= 97) {
        if (symb <= 122) symb -= 32;  // to lowercase
        else symb -= 26;              // 123..126
    }
    return pgm_read_byte(_segCharMap + (symb - 32));
}

uint8_t intLen(int32_t val) {
    if (!val) return 1;
    uint8_t len = (val < 0);
    while (val) {
        len++;
        val /= 10;
    }
    return len;
}

uint8_t floatLen(double val, uint8_t dec) {
    return intLen(val) + dec;
}

}  // namespace sseg